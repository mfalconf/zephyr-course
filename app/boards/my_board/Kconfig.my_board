## app/boards/my_board/Kconfig.my_board
```kconfig
config BOARD_MY_BOARD
	select SOC_ESP32_WROVER_E_N4R8
	select SOC_ESP32_PROCPU if BOARD_MY_BOARD_ESP32_PROCPU
	select SOC_ESP32_APPCPU if BOARD_ESP32_DEVKITC_ESP32_APPCPU
```

## app/boards/my_board/board.yml
```yaml
board:
  name: my_board
  full_name: MY_BOARD_FROM_SCRATCH
  vendor: y-vendor
  socs:
  - name: esp32
```

## app/boards/our_board/board.yml
```yaml
board:
  name: our_board
  full_name: OUR_BOARD
  vendor: x-vendor
  socs:
  - name: esp32
```
